## config/boards/shields/dactylM/Kconfig.defconfig
```kconfig
# Copyright (c) 2020 Ryan Cross
# SPDX-License-Identifier: MIT

if SHIELD_DACTYLM_LEFT

config ZMK_KEYBOARD_NAME
	default "Dactyl manuform"

config ZMK_SPLIT_ROLE_CENTRAL
	default y
	
endif

if SHIELD_DACTYLM_LEFT || SHIELD_DACTYLM_RIGHT

config ZMK_SPLIT
	default y

endif


# Increasing the transmit power of the keyboard's BLE radio 
CONFIG_BT_CTLR_TX_PWR_PLUS_8=y
```

## config/boards/shields/dactylM/Kconfig.shield
```kconfig
config SHIELD_DACTYLM_LEFT
    def_bool $(shields_list_contains,left)

config SHIELD_DACTYLM_RIGHT
    def_bool $(shields_list_contains,right)
```
